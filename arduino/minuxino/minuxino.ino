#include "ssd1306.h"
#include "nano_gfx.h"
#include "sova.h"


const unsigned char marcetuxbitmap [] = {
0x80, 0x00, 0x40, 0x00, 
0x00, 0x00, 0x00, 0x00, 0x00, 0x00, 0x00, 0x00, 0x00, 0x00, 0x00, 0x00, 0x00, 0x00, 0x00, 0x00,
0x00, 0x00, 0x00, 0x00, 0x00, 0x00, 0x00, 0x00, 0x00, 0x00, 0x00, 0x00, 0x00, 0x00, 0x00, 0x00,
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0x00, 0x00, 0x00, 0x00, 0x00, 0x00, 0x00, 0x00, 0x00, 0x00, 0x00, 0x00, 0x00, 0x00, 0x00, 0x00
};




const PROGMEM uint8_t heartImage[8] =
{
    0B00001110,
    0B00011111,
    0B00111111,
    0B01111110,
    0B01111110,
    0B00111101,
    0B00011001,
    0B00001110
};

const int spriteWidth = sizeof(heartImage);

SAppMenu menu;

const char *menuItems[] =
{
    "draw bitmap",
    "sprites",
    "fonts",
    "canvas gfx",
    "draw lines",
};

// === DEMO MODE FLAG ===
bool demoMode = true;

enum Emotion { HAPPY, SAD, ANGRY, CHATTY };
Emotion currentEmotion = HAPPY;

void drawRobotEyes(Emotion mood)
{
    ssd1306_clearScreen();

    uint8_t buffer[128 * 64 / 8];
    NanoCanvas canvas(128, 64, buffer);
    canvas.clear();

    // Head outline
    canvas.drawRect(20, 8, 88, 48);

    // Eye rectangles
    uint8_t eyeW = 6, eyeH = 6;
    uint8_t leftX = 44, rightX = 84, eyeY = 24;

    switch (mood)
    {
        case HAPPY:
            canvas.fillRect(leftX, eyeY, leftX + eyeW, eyeY + eyeH, 0xFF);
            canvas.fillRect(rightX, eyeY, rightX + eyeW, eyeY + eyeH, 0xFF);
            canvas.drawHLine(40, 38, 48); // smile
            break;

        case SAD:
            canvas.fillRect(leftX, eyeY, leftX + eyeW, eyeY + eyeH, 0xFF);
            canvas.fillRect(rightX, eyeY, rightX + eyeW, eyeY + eyeH, 0xFF);
            canvas.drawHLine(40, 44, 48); // frown
            break;

        case ANGRY:
            canvas.drawRect(leftX, eyeY, leftX + eyeW, eyeY + eyeH);
            canvas.drawRect(rightX, eyeY, rightX + eyeW, eyeY + eyeH);
            canvas.drawHLine(40, 20, 16); // left brow
            canvas.drawHLine(80, 20, 16); // right brow
            break;

        case CHATTY:
            canvas.drawRect(leftX, eyeY, leftX + eyeW, eyeY + eyeH);
            canvas.drawRect(rightX, eyeY, rightX + eyeW, eyeY + eyeH);
            canvas.drawHLine(30, 42, 10);
            canvas.drawHLine(45, 46, 20);
            canvas.drawHLine(70, 50, 10);
            break;
    }

    canvas.blt(0, 0);
}


// === ORIGINAL DEMOS ===

static void bitmapDemo()
{
    ssd1306_drawBitmap(0, 0, 128, 64, marcetuxbitmap);
    delay(1000);
    ssd1306_invertMode();
    delay(2000);
    ssd1306_normalMode();
}

static void spriteDemo()
{
    ssd1306_clearScreen();
    SPRITE sprite;
    sprite = ssd1306_createSprite( 0, 0, spriteWidth, heartImage );
    for (int i = 0; i < 250; i++)
    {
        delay(15);
        sprite.x++;
        if (sprite.x >= ssd1306_displayWidth()) sprite.x = 0;
        sprite.y++;
        if (sprite.y >= ssd1306_displayHeight()) sprite.y = 0;
        sprite.eraseTrace();
        sprite.draw();
    }
}

static void textDemo()
{
    ssd1306_setFixedFont(ssd1306xled_font6x8);
    ssd1306_clearScreen();
    ssd1306_printFixed(0,  8, "Normal text", STYLE_NORMAL);
    ssd1306_printFixed(0, 16, "Bold text", STYLE_BOLD);
    ssd1306_printFixed(0, 24, "Italic text", STYLE_ITALIC);
    ssd1306_negativeMode();
    ssd1306_printFixed(0, 32, "Inverted bold", STYLE_BOLD);
    ssd1306_positiveMode();
    delay(3000);
}

static void canvasDemo()
{
    uint8_t buffer[64 * 16 / 8];
    NanoCanvas canvas(64, 16, buffer);
    ssd1306_setFixedFont(ssd1306xled_font6x8);
    ssd1306_clearScreen();
    canvas.clear();
    canvas.fillRect(10, 3, 80, 5, 0xFF);
    canvas.blt((ssd1306_displayWidth() - 64) / 2, 1);
    delay(500);
    canvas.fillRect(50, 1, 60, 15, 0xFF);
    canvas.blt((ssd1306_displayWidth() - 64) / 2, 1);
    delay(1500);
    canvas.printFixed(20, 1, " DEMO ", STYLE_BOLD );
    canvas.blt((ssd1306_displayWidth() - 64) / 2, 1);
    delay(3000);
}

static void drawLinesDemo()
{
    ssd1306_clearScreen();
    for (uint8_t y = 0; y < ssd1306_displayHeight(); y += 8)
    {
        ssd1306_drawLine(0, 0, ssd1306_displayWidth() - 1, y);
    }
    for (uint8_t x = ssd1306_displayWidth() - 1; x > 7; x -= 8)
    {
        ssd1306_drawLine(0, 0, x, ssd1306_displayHeight() - 1);
    }
    delay(3000);
}

// === SETUP ===
void setup()
{
    ssd1306_setFixedFont(ssd1306xled_font6x8);
    ssd1306_128x64_i2c_init();
    ssd1306_clearScreen();

    if (demoMode)
    {
        ssd1306_createMenu(&menu, menuItems, sizeof(menuItems) / sizeof(char *));
        ssd1306_showMenu(&menu);
    }
}

// === MAIN LOOP ===
void loop()
{
    if (demoMode)
    {
        delay(1000);
        switch (ssd1306_menuSelection(&menu))
        {
            case 0: bitmapDemo(); break;
            case 1: spriteDemo(); break;
            case 2: textDemo(); break;
            case 3: canvasDemo(); break;
            case 4: drawLinesDemo(); break;
            default: break;
        }
        ssd1306_clearScreen();
        ssd1306_showMenu(&menu);
        delay(500);
        ssd1306_menuDown(&menu);
        ssd1306_updateMenu(&menu);
    }
    else
    {
        drawRobotEyes(currentEmotion);
        delay(2000);
        currentEmotion = static_cast<Emotion>((currentEmotion + 1) % 4);
    }
}